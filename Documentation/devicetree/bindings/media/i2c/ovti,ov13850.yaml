## Documentation/devicetree/bindings/media/i2c/ovti,ov13850.yaml
```yaml
# SPDX-License-Identifier: (GPL-2.0-only OR BSD-2-Clause)
%YAML 1.2
---
$id: http://devicetree.org/schemas/media/i2c/ovti,ov13850.yaml#
$schema: http://devicetree.org/meta-schemas/core.yaml#

title: OmniVision OV13850 image sensor

maintainers:
  - Rolex Image Builder <root@localhost>

description: |
  The OV13850 is a 13 megapixel CMOS sensor. This driver uses the two-lane
  RAW10 register modes with a 24 MHz external clock and 300 MHz CSI link.
  reset-gpios and pwdn-gpios use active-low polarity on the Redmi 4A board.

properties:
  compatible:
    const: ovti,ov13850
  reg:
    maxItems: 1
  clocks:
    maxItems: 1
  clock-names:
    const: xvclk
  avdd-supply:
    description: Analog supply, 2.8 V.
  dovdd-supply:
    description: Digital I/O supply, 1.8 V.
  dvdd-supply:
    description: Digital core supply, 1.2 V.
  reset-gpios:
    maxItems: 1
    description: Sensor reset, asserted when the logical value is one.
  pwdn-gpios:
    maxItems: 1
    description: Sensor power down, asserted when the logical value is one.
  power-gpios:
    maxItems: 1
    description: Optional board power enable.
  port:
    $ref: /schemas/graph.yaml#/$defs/port-base
    additionalProperties: false
    properties:
      endpoint:
        $ref: /schemas/media/video-interfaces.yaml#
        unevaluatedProperties: false
        properties:
          data-lanes:
            minItems: 2
            maxItems: 2
          link-frequencies:
            items:
              - const: 300000000
        required:
          - data-lanes
          - link-frequencies

allOf:
  - $ref: /schemas/media/video-interface-devices.yaml#

required:
  - compatible
  - reg
  - clocks
  - clock-names
  - avdd-supply
  - dovdd-supply
  - dvdd-supply
  - port

unevaluatedProperties: false
```
